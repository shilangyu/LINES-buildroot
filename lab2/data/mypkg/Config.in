## lab2/data/mypkg/package/dioed/Config.in
```kconfig
config BR2_PACKAGE_DIOED
	bool "dioed"
	depends on BR2_PACKAGE_LIBGPIOD
	help
	  Programmable LEDs using small declarative language

comment "dioed depends on libgpiod library"
	depends on !BR2_PACKAGE_LIBGPIOD
```
